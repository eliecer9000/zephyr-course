## boards/copied_board/board.yml
```yaml
board:
  name: copied_board
  full_name: COPIED-BOARD-FRDM-MCXA156
  vendor: nxp
  socs:
  - name: mcxa156
```

## boards/from_scratch_board/board.yml
```yaml
board:
  name: from_scratch_board
  full_name: FROM-SCRATCH-BOARD-FRDM-MCXA156
  vendor: nxp
  socs:
  - name: mcxa156
```
