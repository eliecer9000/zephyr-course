## app/Kconfig
```kconfig
menuconfig LED_SUBSYSTEM
    bool "LED Subsystem"
    default y

if LED_SUBSYSTEM

choice
    prompt "LED blink sleep time"
    default BLINK_SLEEP_1000MS

config BLINK_SLEEP_250MS
    bool "Fast (250 ms)"

config BLINK_SLEEP_1000MS
    bool "Medium (1000 ms)"

config BLINK_SLEEP_2000MS
    bool "Slow (2000 ms)"

endchoice

config BLINK_SLEEP_TIME_MS
    int
    default 250 if BLINK_SLEEP_250MS
    default 1000 if BLINK_SLEEP_1000MS
    default 2000 if BLINK_SLEEP_2000MS

menuconfig ADVANCED_LED_SETTINGS
    bool "Advanced LED settings"
    default n

if ADVANCED_LED_SETTINGS

config LED_BRIGHTNESS
    int "LED brightness (0 - 100)"
    range 0 100
    default 100

config LED_FADE_DURATION_MS
    int "LED fade duration (ms)"
    range 0 5000
    default 500

endif #ADVANCED_LED_SETTINGS

menu "Expert settings"
    visible if ADVANCED_LED_SETTINGS

config LED_DEBUG
    bool "Enable LED debugging"

config CUSTOM_BLINK_PATTERN
    bool "Custom blink pattern"

endmenu

endif   #LED_SUBSYSTEM

source "Kconfig.zephyr"
```
